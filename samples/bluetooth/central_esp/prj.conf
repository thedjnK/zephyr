## CMakeLists.txt
```
cmake_minimum_required(VERSION 3.24.0)
find_package(Zephyr REQUIRED HINTS $ENV{ZEPHYR_BASE})
project(central_esp)

FILE(GLOB app_sources src/*.c)
target_sources(app PRIVATE ${app_sources})
```

## Kconfig
```
# Copyright 2023 Jamie M.

menu "Application settings"

module = APPLICATION
module-str = application
source "subsys/logging/Kconfig.template.log_config"

menu "ESS profile listeners"

menuconfig APP_ESS_TEMPERATURE
	bool "Temperature"
	default y
	help
	  Enables subscribing to and outputting temperature readings.

menuconfig APP_ESS_HUMIDITY
	bool "Humidity"
	default y
	help
	  Enables subscribing to and outputting humidity readings.

menuconfig APP_ESS_PRESSURE
	bool "Pressure"
	default y
	help
	  Enables subscribing to and outputting pressure readings.

menuconfig APP_ESS_DEW_POINT
	bool "Dew point"
	default y
	help
	  Enables subscribing to and outputting dew point readings.

endmenu

menuconfig APP_BATTERY_LEVEL
	bool "Battery level"
	default y
	help
	  Enables subscribing to and outputting battery level.

choice
	prompt "Output format"
	default APP_OUTPUT_FORMAT_CUSTOM

config APP_OUTPUT_FORMAT_CSV
	bool "CSV"
	help
	  Output will be in CSV format, with headings of each field.

config APP_OUTPUT_FORMAT_CUSTOM
	bool "Custom"
	help
	  Output will be in custom concise format, without headings

endchoice

menu "Output fields"

menuconfig APP_OUTPUT_DEVICE_ADDRESS
	bool "Device address"
	help
	  Include device Bluetooth address in output.

menuconfig APP_OUTPUT_DEVICE_NAME
	bool "Device name"
	help
	  Include device name (from struct) in output.

endmenu

endmenu

source "Kconfig.zephyr"
```

## prj.conf
```kconfig
CONFIG_BT=y
CONFIG_LOG=y
CONFIG_BT_CENTRAL=y
CONFIG_BT_SMP=y
CONFIG_BT_GATT_CLIENT=y
CONFIG_BT_MAX_CONN=2
CONFIG_BT_CTLR_LE_PING=n
CONFIG_BT_CTLR_PRIVACY=n
CONFIG_BT_CTLR_TX_PWR_PLUS_4=y
CONFIG_BT_GATT_SERVICE_CHANGED=n
CONFIG_BT_CTLR_LE_PING=n
CONFIG_BT_CTLR_PRIVACY=n
CONFIG_BT_CTLR_TX_PWR_PLUS_4=y
CONFIG_BT_GATT_SERVICE_CHANGED=n
CONFIG_NEWLIB_LIBC=y
CONFIG_NEWLIB_LIBC_FLOAT_PRINTF=y
CONFIG_FPU=y
CONFIG_SHELL=y
CONFIG_SHELL_PROMPT_UART=""
CONFIG_SHELL_ECHO_STATUS=n
CONFIG_SHELL_WILDCARD=n
CONFIG_SHELL_TAB=n
CONFIG_SHELL_VT100_COMMANDS=n
CONFIG_SHELL_METAKEYS=n
CONFIG_SHELL_HELP=n
CONFIG_SHELL_HISTORY=n
CONFIG_SHELL_STATS=n
CONFIG_SHELL_CMDS=n
CONFIG_DEVICE_SHELL=n
CONFIG_DEVMEM_SHELL=n
CONFIG_KERNEL_SHELL=n
CONFIG_CLOCK_CONTROL_NRF_SHELL=n
CONFIG_MAIN_STACK_SIZE=2048
```

## boards/bl654_dvk.conf
```kconfig
# Copyright (c) 2023 Jamie M.
# All right reserved. This code is not apache or FOSS/copyleft licensed.

# Enable flash and reboot for bootloader functionality
CONFIG_REBOOT=y
CONFIG_FLASH=y
CONFIG_SPI_NOR=n
CONFIG_FLASH_SHELL=n
```

## src/magic.c
```c
/*
 * Copyright (c) 2023 Jamie M.
 *
 * All right reserved. This code is not apache or FOSS/copyleft licensed.
 */

#include <zephyr/linker/sections.h>
#include <zephyr/init.h>
#include <zephyr/kernel.h>
#include <zephyr/devicetree.h>
#include <zephyr/drivers/flash.h>
#include <zephyr/device.h>
#include <zephyr/shell/shell.h>

/*
Z_GENERIC_SECTION(.fake_sd_size) __attribute__((used))
const uint32_t sd_size = 0x1000;
*/

Z_GENERIC_SECTION(.fake_boot_string) __attribute__((used))
//const uint8_t boot_string[] = "Laird_Technology_BL6xxxx";
const uint8_t boot_string[] = {
	0xff, 0xff, 0xff, 0xff, 0xff, 0xff, 0xff, 0xff,
	0xff, 0xff, 0xff, 0xff, 0xff, 0xff, 0xff, 0xff,
	0xff, 0xff, 0xff, 0xff, 0xff, 0xff, 0xff, 0xff,
	0xff, 0xff, 0xff, 0xff, 0xff, 0xff, 0xff, 0xff,
};

static const struct device *flash_device =
		DEVICE_DT_GET_OR_NULL(DT_CHOSEN(zephyr_flash_controller));

extern const uint32_t _fake_boot_string_start[];
//extern const uint32_t _fake_boot_string_size[];

static int fw_bootloader_handler(const struct shell *sh, size_t argc, char **argv)
{
	int rc;

	uint8_t data[] = {0x00, 0x00, 0x00, 0x00};
//uint8_t data[((int32_t)_fake_boot_string_size)];
//memset(data, 0, sizeof(data));

	rc = flash_write(flash_device, (off_t)_fake_boot_string_start, data, sizeof(data));

	shell_print(sh, "done, oh %d", sizeof(data));

	return 0;
}

SHELL_STATIC_SUBCMD_SET_CREATE(fw_cmd,
	/* Command handlers */
	SHELL_CMD(bootloader, NULL, "Go to bootloader", fw_bootloader_handler),

	/* Array terminator. */
	SHELL_SUBCMD_SET_END
);

SHELL_CMD_REGISTER(fw, &fw_cmd, "Firmware commands", NULL);
```
