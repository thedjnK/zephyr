## CMakeLists.txt
```
#
# Copyright (c) 2024, Jamie M.
#
# All right reserved. This code is NOT apache or FOSS/copyleft licensed.
#

cmake_minimum_required(VERSION 3.20.0)

find_package(Zephyr REQUIRED HINTS $ENV{ZEPHYR_BASE})
project(nvs_settings_timing_test)

target_sources(app PRIVATE src/main.c src/settings.c)
```

## prj.conf
```kconfig
CONFIG_GPIO=y
CONFIG_SETTINGS=y
CONFIG_SETTINGS_NVS=y
CONFIG_SETTINGS_RUNTIME=y
CONFIG_NVS=y
CONFIG_FLASH_MAP=y
CONFIG_FLASH=y
CONFIG_NVS_LOOKUP_CACHE=y
CONFIG_NVS_LOOKUP_CACHE_SIZE=16
CONFIG_SETTINGS_NVS_NAME_CACHE=y
CONFIG_SETTINGS_NVS_NAME_CACHE_SIZE=16
CONFIG_CBPRINTF_FP_SUPPORT=y
CONFIG_FP16=n

# Release
CONFIG_SYSTEM_WORKQUEUE_STACK_SIZE=2304
CONFIG_MAIN_STACK_SIZE=1600
CONFIG_ISR_STACK_SIZE=768

CONFIG_INIT_STACKS=y
CONFIG_SPEED_OPTIMIZATIONS=y
CONFIG_LOG=y
CONFIG_LOG_PROCESS_TRIGGER_THRESHOLD=6
CONFIG_LOG_PROCESS_THREAD_SLEEP_MS=512
CONFIG_LOG_SPEED=y
```

## src/main.c
```c
/*
 * Copyright (c) 2024, Jamie M.
 *
 * All right reserved. This code is NOT apache or FOSS/copyleft licensed.
 */

#include <zephyr/kernel.h>
#include <stdio.h>
#include "settings.h"
#include <zephyr/settings/settings.h>

#include <zephyr/logging/log.h>

LOG_MODULE_REGISTER(main, 4);

uint8_t dummy_dev_eui[LORA_DEV_EUI_SIZE] = {0x96, 0xac, 0xba, 0x35, 0x60, 0x26, 0xad, 0x1c};
uint8_t dummy_join_eui[LORA_JOIN_EUI_SIZE] = {0xf5, 0x26, 0x14, 0xf8, 0x54, 0xfc, 0x0e, 0x9c};
uint8_t dummy_app_key[LORA_APP_KEY_SIZE] = {0x41, 0x04, 0x5b, 0x8b, 0x86, 0x48, 0x29, 0xe0, 0xe1, 0xc0, 0x73, 0x71, 0xb8, 0x38, 0xa1, 0x05};
uint8_t dummy_power_offset[POWER_OFFSET_MV_SIZE] = {0x00, 0x88};
uint8_t dummy_name[] = "lol fake";
uint8_t dummy_passkey[BLUETOOTH_FIXED_PASSKEY_SIZE] = {0x34, 0x12, 0x00, 0x00};
uint32_t dummy_num = 0;

int main(void)
{
	int rc;
	uint8_t read_dev_eui[LORA_DEV_EUI_SIZE];
	uint8_t read_join_eui[LORA_JOIN_EUI_SIZE];
	uint8_t read_app_key[LORA_APP_KEY_SIZE];
	uint8_t read_power_offset[POWER_OFFSET_MV_SIZE];
	uint8_t read_name[20];
	uint8_t read_passkey[BLUETOOTH_FIXED_PASSKEY_SIZE];
	uint32_t read_num;

	settings_load();
	lora_keys_load();
	app_keys_load();
	other_keys_load();

	//Set dummy keys
	rc = settings_runtime_set("lora_keys/dev_eui", dummy_dev_eui, sizeof(dummy_dev_eui));

	if (rc) {
		LOG_ERR("set1 fail: %d", rc);
	}

	rc = settings_runtime_set("lora_keys/join_eui", dummy_join_eui, sizeof(dummy_join_eui));

	if (rc) {
		LOG_ERR("set2 fail: %d", rc);
	}

	rc = settings_runtime_set("lora_keys/app_key", dummy_app_key, sizeof(dummy_app_key));

	if (rc) {
		LOG_ERR("set3 fail: %d", rc);
	}

	rc = settings_runtime_set("app/power_offset", dummy_power_offset, sizeof(dummy_power_offset));

	if (rc) {
		LOG_ERR("set4 fail: %d", rc);
	}

	rc = settings_runtime_set("app/bluetooth_name", dummy_name, sizeof(dummy_name));

	if (rc) {
		LOG_ERR("set5 fail: %d", rc);
	}

	rc = settings_runtime_set("app/bluetooth_fixed_passkey", dummy_passkey, sizeof(dummy_passkey));

	if (rc) {
		LOG_ERR("set6 fail: %d", rc);
	}

	//Get default
	rc = settings_runtime_get("other/num", &dummy_num, sizeof(dummy_num));

	if (rc < 0) {
		LOG_ERR("get1 fail: %d", rc);
	}

	uint32_t loop = 1;

	while (1) {
		//Clear
		uint32_t uptime_start;
		uint32_t uptime_end;
		LOG_ERR("Loop %d...", loop);
		uptime_start = k_uptime_get_32();
		memset(read_dev_eui, 0, LORA_DEV_EUI_SIZE);
		memset(read_join_eui, 0, LORA_JOIN_EUI_SIZE);
		memset(read_app_key, 0, LORA_APP_KEY_SIZE);
		memset(read_power_offset, 0, POWER_OFFSET_MV_SIZE);
		memset(read_name, 0, 20);
		memset(read_passkey, 0, BLUETOOTH_FIXED_PASSKEY_SIZE);
		read_num = 0;

		//Get
		rc = settings_runtime_get("other/num", &read_num, sizeof(read_num));

		if (rc != sizeof(read_num)) {
			LOG_ERR("get2 fail: %d", rc);
		}

		if (read_num != dummy_num) {
			LOG_ERR("num mistmatch, expected %d got %d, rc: %d", dummy_num, read_num, rc);
		}

		//Update
		++dummy_num;
		rc = settings_runtime_set("other/num", &dummy_num, sizeof(dummy_num));

		if (rc < 0) {
			LOG_ERR("set7 fail: %d", rc);
		}

		//Fetch others
		rc = settings_runtime_get("other/num", &read_num, sizeof(read_num));

		if (rc != sizeof(read_num)) {
			LOG_ERR("get3 fail: %d", rc);
		}

		rc = settings_runtime_get("lora_keys/dev_eui", read_dev_eui, sizeof(read_dev_eui));

		if (rc != sizeof(read_dev_eui)) {
			LOG_ERR("get4 fail: %d", rc);
		}

		rc = settings_runtime_get("lora_keys/join_eui", read_join_eui, sizeof(read_join_eui));

		if (rc != sizeof(read_join_eui)) {
			LOG_ERR("get5 fail: %d", rc);
		}

		rc = settings_runtime_get("lora_keys/app_key", read_app_key, sizeof(read_app_key));

		if (rc != sizeof(read_app_key)) {
			LOG_ERR("get6 fail: %d", rc);
		}

		rc = settings_runtime_get("app/power_offset", read_power_offset, sizeof(read_power_offset));

		if (rc != sizeof(read_power_offset)) {
			LOG_ERR("get7 fail: %d", rc);
		}

		rc = settings_runtime_get("app/bluetooth_name", read_name, sizeof(read_name));

		if (rc < 3) {
			LOG_ERR("get8 fail: %d", rc);
		}

		rc = settings_runtime_get("app/bluetooth_fixed_passkey", read_passkey, sizeof(read_passkey));

		if (rc != sizeof(read_passkey)) {
			LOG_ERR("get9 fail: %d", rc);
		}

		//Compare data
		if (memcmp(dummy_dev_eui, read_dev_eui, sizeof(read_dev_eui)) != 0) {
			LOG_ERR("cmp1 fail");
			LOG_HEXDUMP_ERR(dummy_dev_eui, sizeof(read_dev_eui), "expected");
			LOG_HEXDUMP_ERR(read_dev_eui, sizeof(read_dev_eui), "got");
		}

		if (memcmp(dummy_join_eui, read_join_eui, sizeof(read_join_eui)) != 0) {
			LOG_ERR("cmp2 fail");
			LOG_HEXDUMP_ERR(dummy_join_eui, sizeof(read_join_eui), "expected");
			LOG_HEXDUMP_ERR(read_join_eui, sizeof(read_join_eui), "got");
		}

		if (memcmp(dummy_app_key, read_app_key, sizeof(read_app_key)) != 0) {
			LOG_ERR("cmp3 fail");
			LOG_HEXDUMP_ERR(dummy_app_key, sizeof(read_app_key), "expected");
			LOG_HEXDUMP_ERR(read_app_key, sizeof(read_app_key), "got");
		}

		if (memcmp(dummy_power_offset, read_power_offset, sizeof(read_power_offset)) != 0) {
			LOG_ERR("cmp4 fail");
			LOG_HEXDUMP_ERR(dummy_power_offset, sizeof(read_power_offset), "expected");
			LOG_HEXDUMP_ERR(read_power_offset, sizeof(read_power_offset), "got");
		}

		if (memcmp(dummy_name, read_name, strlen(dummy_name)) != 0) {
			LOG_ERR("cmp5 fail");
			LOG_HEXDUMP_ERR(dummy_name, sizeof(read_name), "expected");
			LOG_HEXDUMP_ERR(read_name, sizeof(read_name), "got");
		}

		if (memcmp(dummy_passkey, read_passkey, sizeof(read_passkey)) != 0) {
			LOG_ERR("cmp6 fail");
			LOG_HEXDUMP_ERR(dummy_passkey, sizeof(read_passkey), "expected");
			LOG_HEXDUMP_ERR(read_passkey, sizeof(read_passkey), "got");
		}

		if (read_num != dummy_num) {
			LOG_ERR("cmp7 fail, expected %d got %d", dummy_num, read_num);
		}

		uptime_end = k_uptime_get_32();
		LOG_ERR("Finished in %dms", (uptime_end - uptime_start));

		k_sleep(K_MSEC(350));
		++loop;
	}

	return 0;
}
```

## src/settings.c
```c
/*
 * Copyright (c) 2024, Jamie M.
 *
 * All right reserved. This code is NOT apache or FOSS/copyleft licensed.
 */

#include <zephyr/kernel.h>
#include <zephyr/settings/settings.h>
#include <zephyr/logging/log.h>
#include "settings.h"

LOG_MODULE_REGISTER(app_settings, 3);

#define MAX_SETTING_KEY_LENGTH 24

static uint8_t lora_dev_eui[LORA_DEV_EUI_SIZE];
static uint8_t lora_join_eui[LORA_JOIN_EUI_SIZE];
static uint8_t lora_app_key[LORA_APP_KEY_SIZE];
static uint16_t power_offset_mv;
static uint8_t bluetooth_device_name[BLUETOOTH_DEVICE_NAME_SIZE] = "hee";
static uint8_t bluetooth_fixed_passkey[BLUETOOTH_FIXED_PASSKEY_SIZE];
static uint32_t num;

static int lora_keys_handle_set(const char *name, size_t len, settings_read_cb read_cb,
				void *cb_arg)
{
	const char *next;
	size_t name_len;
	int rc = -ENOENT;
	uint8_t *output = NULL;
	uint8_t output_size = 0;

	name_len = settings_name_next(name, &next);

	if (!next) {
		if (strncmp(name, "dev_eui", name_len) == 0) {
			output = lora_dev_eui;
			output_size = sizeof(lora_dev_eui);
		} else if (strncmp(name, "join_eui", name_len) == 0) {
			output = lora_join_eui;
			output_size = sizeof(lora_join_eui);
		} else if (strncmp(name, "app_key", name_len) == 0) {
			output = lora_app_key;
			output_size = sizeof(lora_app_key);
		}
	}

	if (output != NULL) {
		if (len != output_size) {
			return -EINVAL;
		}

		rc = read_cb(cb_arg, output, output_size);

		if (rc < 0) {
			goto finish;
		}

		rc = 0;
	}

	if (rc == 0) {
		uint8_t key_name[MAX_SETTING_KEY_LENGTH] = "lora_keys/";

		strcpy(&key_name[strlen(key_name)], name);

		rc = settings_save_one(key_name, output, len);
	}

finish:
	return rc;
}

static int lora_keys_handle_export(int (*cb)(const char *name, const void *value, size_t val_len))
{
	(void)cb("lora_keys/dev_eui", lora_dev_eui, sizeof(lora_dev_eui));
	(void)cb("lora_keys/join_eui", lora_join_eui, sizeof(lora_join_eui));
	(void)cb("lora_keys/app_key", lora_app_key, sizeof(lora_app_key));

	return 0;
}

static int lora_keys_handle_commit(void)
{
	return 0;
}

static int lora_keys_handle_get(const char *name, char *val, int val_len_max)
{
	const char *next;

	if (settings_name_steq(name, "dev_eui", &next) && !next) {
		if (val_len_max < sizeof(lora_dev_eui)) {
			return -E2BIG;
		}

		memcpy(val, lora_dev_eui, sizeof(lora_dev_eui));
		return sizeof(lora_dev_eui);
	} else if (settings_name_steq(name, "join_eui", &next) && !next) {
		if (val_len_max < sizeof(lora_join_eui)) {
			return -E2BIG;
		}

		memcpy(val, lora_join_eui, sizeof(lora_join_eui));
		return sizeof(lora_join_eui);
	} else if (settings_name_steq(name, "app_key", &next) && !next) {
		if (val_len_max < sizeof(lora_app_key)) {
			return -E2BIG;
		}

		memcpy(val, lora_app_key, sizeof(lora_app_key));
		return sizeof(lora_app_key);
	}

	return -ENOENT;
}

void lora_keys_load(void)
{
	settings_subsys_init();
	settings_load_subtree("lora_keys");
}

void lora_keys_clear(void)
{
	(void)settings_delete("lora_keys");
}

SETTINGS_STATIC_HANDLER_DEFINE(lora_keys, "lora_keys", lora_keys_handle_get, lora_keys_handle_set,
			       lora_keys_handle_commit, lora_keys_handle_export);


/* Application settings */

static int app_handle_set(const char *name, size_t len, settings_read_cb read_cb,
				void *cb_arg)
{
	const char *next;
	size_t name_len;
	int rc = -ENOENT;
	uint8_t *output = NULL;
	uint8_t output_size = 0;

	name_len = settings_name_next(name, &next);

	if (!next) {
		if (strncmp(name, "power_offset", name_len) == 0) {
			output = (uint8_t *)&power_offset_mv;
			output_size = sizeof(power_offset_mv);
		}
		if (strncmp(name, "bluetooth_name", name_len) == 0) {
			if (len == 0 || len >= sizeof(bluetooth_device_name) || ((uint8_t *)cb_arg)[len] == 0) {
				return -EINVAL;
			}

			output = bluetooth_device_name;
			output_size = sizeof(bluetooth_device_name);
			memset(bluetooth_device_name, 0, sizeof(bluetooth_device_name));
			goto save;
		}
		if (strncmp(name, "bluetooth_fixed_passkey", name_len) == 0) {
			output = bluetooth_fixed_passkey;
			output_size = sizeof(bluetooth_fixed_passkey);
		}
	}

	if (output != NULL) {
		if (len != output_size) {
			return -EINVAL;
		}

save:
		rc = read_cb(cb_arg, output, output_size);

		if (rc < 0) {
			goto finish;
		}

		rc = 0;
	}

	if (rc == 0) {
		uint8_t key_name[MAX_SETTING_KEY_LENGTH] = "app/";

		strcpy(&key_name[strlen(key_name)], name);

		rc = settings_save_one(key_name, output, len);
	}

finish:
	return rc;
}

static int app_handle_export(int (*cb)(const char *name, const void *value, size_t val_len))
{
	(void)cb("app/power_offset", &power_offset_mv, sizeof(power_offset_mv));
	(void)cb("app/bluetooth_name", bluetooth_device_name, strlen(bluetooth_device_name));
	(void)cb("app/bluetooth_fixed_passkey", bluetooth_fixed_passkey, sizeof(bluetooth_fixed_passkey));

	return 0;
}

static int app_handle_commit(void)
{
	return 0;
}

static int app_handle_get(const char *name, char *val, int val_len_max)
{
	const char *next;

	if (settings_name_steq(name, "power_offset", &next) && !next) {
		if (val_len_max < sizeof(power_offset_mv)) {
			return -E2BIG;
		}

		memcpy(val, &power_offset_mv, sizeof(power_offset_mv));
		return sizeof(power_offset_mv);
	}
	if (settings_name_steq(name, "bluetooth_name", &next) && !next) {
		if (val_len_max < strlen(bluetooth_device_name)) {
			return -E2BIG;
		}

		memcpy(val, bluetooth_device_name, strlen(bluetooth_device_name));
		return strlen(bluetooth_device_name);
	}
	if (settings_name_steq(name, "bluetooth_fixed_passkey", &next) && !next) {
		if (val_len_max < sizeof(bluetooth_fixed_passkey)) {
			return -E2BIG;
		}

		memcpy(val, &bluetooth_fixed_passkey, sizeof(bluetooth_fixed_passkey));
		return sizeof(bluetooth_fixed_passkey);
	}

	return -ENOENT;
}

void app_keys_load(void)
{
	settings_load_subtree("app");
}

void app_keys_clear(void)
{
	(void)settings_delete("app");
}

SETTINGS_STATIC_HANDLER_DEFINE(app, "app", app_handle_get, app_handle_set,
			       app_handle_commit, app_handle_export);


static int other_handle_set(const char *name, size_t len, settings_read_cb read_cb,
				void *cb_arg)
{
	const char *next;
	size_t name_len;
	int rc = -ENOENT;
	uint8_t *output = NULL;
	uint8_t output_size = 0;

	name_len = settings_name_next(name, &next);

	if (!next) {
		if (strncmp(name, "num", name_len) == 0) {
			output = (uint8_t *)&num;
			output_size = sizeof(num);
		}
	}

	if (output != NULL) {
		if (len != output_size) {
			return -EINVAL;
		}

		rc = read_cb(cb_arg, output, output_size);

		if (rc < 0) {
			goto finish;
		}

		rc = 0;
	}

	if (rc == 0) {
		uint8_t key_name[MAX_SETTING_KEY_LENGTH] = "num/";

		strcpy(&key_name[strlen(key_name)], name);

		rc = settings_save_one(key_name, output, len);
	}

finish:
	return rc;
}

static int other_handle_export(int (*cb)(const char *name, const void *value, size_t val_len))
{
	(void)cb("other/num", &num, sizeof(num));

	return 0;
}

static int other_handle_commit(void)
{
	return 0;
}

static int other_handle_get(const char *name, char *val, int val_len_max)
{
	const char *next;

	if (settings_name_steq(name, "num", &next) && !next) {
		if (val_len_max < sizeof(num)) {
			return -E2BIG;
		}

		memcpy(val, &num, sizeof(num));
		return sizeof(num);
	}

	return -ENOENT;
}

void other_keys_load(void)
{
	settings_load_subtree("other");
}

void other_keys_clear(void)
{
	(void)settings_delete("other");
}

SETTINGS_STATIC_HANDLER_DEFINE(other, "other", other_handle_get, other_handle_set,
			       other_handle_commit, other_handle_export);
```

## src/settings.h
```c
/*
 * Copyright (c) 2024, Jamie M.
 *
 * All right reserved. This code is NOT apache or FOSS/copyleft licensed.
 */

#define LORA_DEV_EUI_SIZE 8
#define LORA_JOIN_EUI_SIZE 8
#define LORA_APP_KEY_SIZE 16
#define POWER_OFFSET_MV_SIZE 2
#define BLUETOOTH_DEVICE_NAME_SIZE 14
#define BLUETOOTH_FIXED_PASSKEY_SIZE 4

/* Load LoRa keys */
void lora_keys_load(void);

/* Clear LoRa keys */
void lora_keys_clear(void);

/* Load application keys */
void app_keys_load(void);

/* Clear application keys */
void app_keys_clear(void);

/* Load application keys */
void other_keys_load(void);

/* Clear application keys */
void other_keys_clear(void);
```
